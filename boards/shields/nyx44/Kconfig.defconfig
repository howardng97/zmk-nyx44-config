## boards/shields/nyx44/Kconfig.defconfig
```kconfig
# Copyright (c) 2022 The ZMK Contributors
# SPDX-License-Identifier: MIT

if SHIELD_NYX44_LEFT

config ZMK_KEYBOARD_NAME
    default "Nyx44"

config ZMK_SPLIT_ROLE_CENTRAL
    default y

endif 

if SHIELD_NYX44_LEFT || SHIELD_NYX44_RIGHT

config ZMK_SPLIT
    default y

endif 
```
